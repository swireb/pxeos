## Buildroot/package/libhivex/Config.in
```kconfig
config BR2_PACKAGE_LIBHIVEX
	bool "libhivex"
	help
	  Read and write Windows Registry hive files.  PXEOS uses the C library
	  only; language bindings and interactive tools are not installed.
```

## Buildroot/package/rootpxe-offline-identities/Config.in
```kconfig
config BR2_PACKAGE_ROOTPXE_OFFLINE_IDENTITIES
	bool "RootPXE Windows offline hostname verification"
	select BR2_PACKAGE_LIBHIVEX
	help
	  Inspect and verify the offline SYSTEM hive around a PXEOS Windows
	  computer-name update. The helper intentionally has no storage or BCD
	  repair command.
```

## Buildroot/package/rootpxe-storage-io/Config.in
```kconfig
config BR2_PACKAGE_ROOTPXE_STORAGE_IO
	bool "rootpxe-storage-io"
	select BR2_PACKAGE_JSON_C
	select BR2_PACKAGE_OPENSSL
	help
	  RootPXE task-bound NAS operations and restricted native NFS mounting.
```
